## Documentation/devicetree/bindings/mips/realtek.yaml
```yaml
# SPDX-License-Identifier: GPL-2.0
%YAML 1.2
---
$id: http://devicetree.org/schemas/mips/realtek.yaml#
$schema: http://devicetree.org/meta-schemas/core.yaml#

title: Realtek MIPS SoC based Platforms Device Tree Bindings

maintainers:
  - Birger Koblitz <mail@birger-koblitz.de>
  - Bert Vermeulen <bert@biot.com>
  - John Crispin <john@phrozen.org>

description: |
  Boards with a MediaTek SoC shall have the following properties.

properties:
  $nodename:
    const: '/'
  compatible:
    oneOf:
      - description: Cisco SG220-26
        items:
          - const: cisco,sg220-26
          - const: realtek,rtl8380-soc
      - description: Cisco SG220-26
        items:
          - const: zyxel,gs1900-10hp
          - const: realtek,rtl8380-soc

additionalProperties: true

...
```

## arch/mips/realtek/Kconfig
```kconfig
if MACH_REALTEK
choice
       prompt "Realtek RTL838x/RTL839x-based switch"
       optional

       config DT_CISCO_SG220_26
               bool "Cisco SG220-26"
       config DT_ZYXEL_GS1900_10HP
               bool "Zyxel GS1900-10HP"
endchoice
endif
```
